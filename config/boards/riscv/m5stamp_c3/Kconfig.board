## config/boards/riscv/m5stamp_c3/Kconfig.board
```kconfig
menu "M5Stamp C3 Board"

config BOARD_M5STAMP_C3
    bool "M5Stamp C3"
    select SOC_ESP32C3

endmenu
```

## config/boards/riscv/m5stamp_c3/board.yml
```yaml
board:
  name: m5stamp_c3
  vendor: m5stack
  soc: esp32c3
  arch: riscv
  toolchain: zephyr
  features:
    - ble
    - usb
    - keys
```

## config/west.yml
```yaml
manifest:
  remotes:
    - name: zmkfirmware
      url-base: https://github.com/akira2390
  projects:
    - name: zmk
      remote: akira2390
      revision: core/move-to-zephyr-4-1
      import: app/west.yml
  self:
    path: config
```
