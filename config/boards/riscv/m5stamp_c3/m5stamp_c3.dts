/dts-v1/;
#include <espressif/esp32c3.dtsi>

/ {
    model = "M5Stamp C3 for Dactyl Manuform";
    compatible = "m5stack,stamp_c3", "espressif,esp32c3";

    chosen {
        zephyr,console = &uart0;
    };

    matrix {
        compatible = "zmk,matrix-transform";
        rows = <6>;
        cols = <6>;
        row-gpios = <&gpio0 0 GPIO_ACTIVE_HIGH>,
                    <&gpio0 1 GPIO_ACTIVE_HIGH>,
                    <&gpio0 4 GPIO_ACTIVE_HIGH>,
                    <&gpio0 5 GPIO_ACTIVE_HIGH>,
                    <&gpio0 6 GPIO_ACTIVE_HIGH>,
                    <&gpio0 7 GPIO_ACTIVE_HIGH>;
        col-gpios = <&gpio0 8 GPIO_ACTIVE_LOW>,
                    <&gpio0 9 GPIO_ACTIVE_LOW>,
                    <&gpio0 10 GPIO_ACTIVE_LOW>,
                    <&gpio0 18 GPIO_ACTIVE_LOW>,
                    <&gpio0 19 GPIO_ACTIVE_LOW>,
                    <&gpio0 20 GPIO_ACTIVE_LOW>;
        debounce-press-ms = <5>;
        debounce-release-ms = <5>;
    };
};
