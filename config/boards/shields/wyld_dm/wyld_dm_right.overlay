// wyld_dm_right.overlay

#include "wyld_dm.dtsi"

&default_transform {
    col-offset = <6>;
};

&kscan0 {
    col-gpios
			= <&gpio0 0  GPIO_ACTIVE_HIGH>
			, <&gpio0 1  GPIO_ACTIVE_HIGH>
			, <&gpio0 9  GPIO_ACTIVE_HIGH>
			, <&gpio0 10  GPIO_ACTIVE_HIGH>
			, <&gpio0 18  GPIO_ACTIVE_HIGH>
            , <&gpio0 19  GPIO_ACTIVE_HIGH>
			;
};

